/*******************************************************************************
* File Name: cyfittergnu.inc
* 
* PSoC Creator  4.4
*
* Description:
* 
* This file is automatically generated by PSoC Creator.
*
********************************************************************************
* Copyright (c) 2007-2020 Cypress Semiconductor.  All rights reserved.
* You may use this file only in accordance with the license, terms, conditions, 
* disclaimers, and limitations in the end user license agreement accompanying 
* the software package with which this file was provided.
********************************************************************************/

.ifndef INCLUDED_CYFITTERGNU_INC
.set INCLUDED_CYFITTERGNU_INC, 1
.include "cydevicegnu.inc"
.include "cydevicegnu_trm.inc"

/* Rx_1 */
.set Rx_1__0__INTTYPE, CYREG_PICU3_INTTYPE1
.set Rx_1__0__MASK, 0x02
.set Rx_1__0__PC, CYREG_PRT3_PC1
.set Rx_1__0__PORT, 3
.set Rx_1__0__SHIFT, 1
.set Rx_1__AG, CYREG_PRT3_AG
.set Rx_1__AMUX, CYREG_PRT3_AMUX
.set Rx_1__BIE, CYREG_PRT3_BIE
.set Rx_1__BIT_MASK, CYREG_PRT3_BIT_MASK
.set Rx_1__BYP, CYREG_PRT3_BYP
.set Rx_1__CTL, CYREG_PRT3_CTL
.set Rx_1__DM0, CYREG_PRT3_DM0
.set Rx_1__DM1, CYREG_PRT3_DM1
.set Rx_1__DM2, CYREG_PRT3_DM2
.set Rx_1__DR, CYREG_PRT3_DR
.set Rx_1__INP_DIS, CYREG_PRT3_INP_DIS
.set Rx_1__INTTYPE_BASE, CYDEV_PICU_INTTYPE_PICU3_BASE
.set Rx_1__LCD_COM_SEG, CYREG_PRT3_LCD_COM_SEG
.set Rx_1__LCD_EN, CYREG_PRT3_LCD_EN
.set Rx_1__MASK, 0x02
.set Rx_1__PORT, 3
.set Rx_1__PRT, CYREG_PRT3_PRT
.set Rx_1__PRTDSI__CAPS_SEL, CYREG_PRT3_CAPS_SEL
.set Rx_1__PRTDSI__DBL_SYNC_IN, CYREG_PRT3_DBL_SYNC_IN
.set Rx_1__PRTDSI__OE_SEL0, CYREG_PRT3_OE_SEL0
.set Rx_1__PRTDSI__OE_SEL1, CYREG_PRT3_OE_SEL1
.set Rx_1__PRTDSI__OUT_SEL0, CYREG_PRT3_OUT_SEL0
.set Rx_1__PRTDSI__OUT_SEL1, CYREG_PRT3_OUT_SEL1
.set Rx_1__PRTDSI__SYNC_OUT, CYREG_PRT3_SYNC_OUT
.set Rx_1__PS, CYREG_PRT3_PS
.set Rx_1__SHIFT, 1
.set Rx_1__SLW, CYREG_PRT3_SLW

/* Tx_1 */
.set Tx_1__0__INTTYPE, CYREG_PICU3_INTTYPE0
.set Tx_1__0__MASK, 0x01
.set Tx_1__0__PC, CYREG_PRT3_PC0
.set Tx_1__0__PORT, 3
.set Tx_1__0__SHIFT, 0
.set Tx_1__AG, CYREG_PRT3_AG
.set Tx_1__AMUX, CYREG_PRT3_AMUX
.set Tx_1__BIE, CYREG_PRT3_BIE
.set Tx_1__BIT_MASK, CYREG_PRT3_BIT_MASK
.set Tx_1__BYP, CYREG_PRT3_BYP
.set Tx_1__CTL, CYREG_PRT3_CTL
.set Tx_1__DM0, CYREG_PRT3_DM0
.set Tx_1__DM1, CYREG_PRT3_DM1
.set Tx_1__DM2, CYREG_PRT3_DM2
.set Tx_1__DR, CYREG_PRT3_DR
.set Tx_1__INP_DIS, CYREG_PRT3_INP_DIS
.set Tx_1__INTTYPE_BASE, CYDEV_PICU_INTTYPE_PICU3_BASE
.set Tx_1__LCD_COM_SEG, CYREG_PRT3_LCD_COM_SEG
.set Tx_1__LCD_EN, CYREG_PRT3_LCD_EN
.set Tx_1__MASK, 0x01
.set Tx_1__PORT, 3
.set Tx_1__PRT, CYREG_PRT3_PRT
.set Tx_1__PRTDSI__CAPS_SEL, CYREG_PRT3_CAPS_SEL
.set Tx_1__PRTDSI__DBL_SYNC_IN, CYREG_PRT3_DBL_SYNC_IN
.set Tx_1__PRTDSI__OE_SEL0, CYREG_PRT3_OE_SEL0
.set Tx_1__PRTDSI__OE_SEL1, CYREG_PRT3_OE_SEL1
.set Tx_1__PRTDSI__OUT_SEL0, CYREG_PRT3_OUT_SEL0
.set Tx_1__PRTDSI__OUT_SEL1, CYREG_PRT3_OUT_SEL1
.set Tx_1__PRTDSI__SYNC_OUT, CYREG_PRT3_SYNC_OUT
.set Tx_1__PS, CYREG_PRT3_PS
.set Tx_1__SHIFT, 0
.set Tx_1__SLW, CYREG_PRT3_SLW

/* UART */
.set UART_BUART_sTX_sCLOCK_TxBitClkGen__16BIT_A0_REG, CYREG_B1_UDB05_06_A0
.set UART_BUART_sTX_sCLOCK_TxBitClkGen__16BIT_A1_REG, CYREG_B1_UDB05_06_A1
.set UART_BUART_sTX_sCLOCK_TxBitClkGen__16BIT_D0_REG, CYREG_B1_UDB05_06_D0
.set UART_BUART_sTX_sCLOCK_TxBitClkGen__16BIT_D1_REG, CYREG_B1_UDB05_06_D1
.set UART_BUART_sTX_sCLOCK_TxBitClkGen__16BIT_DP_AUX_CTL_REG, CYREG_B1_UDB05_06_ACTL
.set UART_BUART_sTX_sCLOCK_TxBitClkGen__16BIT_F0_REG, CYREG_B1_UDB05_06_F0
.set UART_BUART_sTX_sCLOCK_TxBitClkGen__16BIT_F1_REG, CYREG_B1_UDB05_06_F1
.set UART_BUART_sTX_sCLOCK_TxBitClkGen__A0_A1_REG, CYREG_B1_UDB05_A0_A1
.set UART_BUART_sTX_sCLOCK_TxBitClkGen__A0_REG, CYREG_B1_UDB05_A0
.set UART_BUART_sTX_sCLOCK_TxBitClkGen__A1_REG, CYREG_B1_UDB05_A1
.set UART_BUART_sTX_sCLOCK_TxBitClkGen__D0_D1_REG, CYREG_B1_UDB05_D0_D1
.set UART_BUART_sTX_sCLOCK_TxBitClkGen__D0_REG, CYREG_B1_UDB05_D0
.set UART_BUART_sTX_sCLOCK_TxBitClkGen__D1_REG, CYREG_B1_UDB05_D1
.set UART_BUART_sTX_sCLOCK_TxBitClkGen__DP_AUX_CTL_REG, CYREG_B1_UDB05_ACTL
.set UART_BUART_sTX_sCLOCK_TxBitClkGen__F0_F1_REG, CYREG_B1_UDB05_F0_F1
.set UART_BUART_sTX_sCLOCK_TxBitClkGen__F0_REG, CYREG_B1_UDB05_F0
.set UART_BUART_sTX_sCLOCK_TxBitClkGen__F1_REG, CYREG_B1_UDB05_F1
.set UART_BUART_sTX_TxShifter_u0__16BIT_A0_REG, CYREG_B1_UDB04_05_A0
.set UART_BUART_sTX_TxShifter_u0__16BIT_A1_REG, CYREG_B1_UDB04_05_A1
.set UART_BUART_sTX_TxShifter_u0__16BIT_D0_REG, CYREG_B1_UDB04_05_D0
.set UART_BUART_sTX_TxShifter_u0__16BIT_D1_REG, CYREG_B1_UDB04_05_D1
.set UART_BUART_sTX_TxShifter_u0__16BIT_DP_AUX_CTL_REG, CYREG_B1_UDB04_05_ACTL
.set UART_BUART_sTX_TxShifter_u0__16BIT_F0_REG, CYREG_B1_UDB04_05_F0
.set UART_BUART_sTX_TxShifter_u0__16BIT_F1_REG, CYREG_B1_UDB04_05_F1
.set UART_BUART_sTX_TxShifter_u0__A0_A1_REG, CYREG_B1_UDB04_A0_A1
.set UART_BUART_sTX_TxShifter_u0__A0_REG, CYREG_B1_UDB04_A0
.set UART_BUART_sTX_TxShifter_u0__A1_REG, CYREG_B1_UDB04_A1
.set UART_BUART_sTX_TxShifter_u0__D0_D1_REG, CYREG_B1_UDB04_D0_D1
.set UART_BUART_sTX_TxShifter_u0__D0_REG, CYREG_B1_UDB04_D0
.set UART_BUART_sTX_TxShifter_u0__D1_REG, CYREG_B1_UDB04_D1
.set UART_BUART_sTX_TxShifter_u0__DP_AUX_CTL_REG, CYREG_B1_UDB04_ACTL
.set UART_BUART_sTX_TxShifter_u0__F0_F1_REG, CYREG_B1_UDB04_F0_F1
.set UART_BUART_sTX_TxShifter_u0__F0_REG, CYREG_B1_UDB04_F0
.set UART_BUART_sTX_TxShifter_u0__F1_REG, CYREG_B1_UDB04_F1
.set UART_BUART_sTX_TxSts__0__MASK, 0x01
.set UART_BUART_sTX_TxSts__0__POS, 0
.set UART_BUART_sTX_TxSts__1__MASK, 0x02
.set UART_BUART_sTX_TxSts__1__POS, 1
.set UART_BUART_sTX_TxSts__16BIT_STATUS_AUX_CTL_REG, CYREG_B1_UDB04_05_ACTL
.set UART_BUART_sTX_TxSts__16BIT_STATUS_REG, CYREG_B1_UDB04_05_ST
.set UART_BUART_sTX_TxSts__2__MASK, 0x04
.set UART_BUART_sTX_TxSts__2__POS, 2
.set UART_BUART_sTX_TxSts__3__MASK, 0x08
.set UART_BUART_sTX_TxSts__3__POS, 3
.set UART_BUART_sTX_TxSts__MASK, 0x0F
.set UART_BUART_sTX_TxSts__MASK_REG, CYREG_B1_UDB04_MSK
.set UART_BUART_sTX_TxSts__STATUS_AUX_CTL_REG, CYREG_B1_UDB04_ACTL
.set UART_BUART_sTX_TxSts__STATUS_REG, CYREG_B1_UDB04_ST
.set UART_IntClock__CFG0, CYREG_CLKDIST_DCFG1_CFG0
.set UART_IntClock__CFG1, CYREG_CLKDIST_DCFG1_CFG1
.set UART_IntClock__CFG2, CYREG_CLKDIST_DCFG1_CFG2
.set UART_IntClock__CFG2_SRC_SEL_MASK, 0x07
.set UART_IntClock__INDEX, 0x01
.set UART_IntClock__PM_ACT_CFG, CYREG_PM_ACT_CFG2
.set UART_IntClock__PM_ACT_MSK, 0x02
.set UART_IntClock__PM_STBY_CFG, CYREG_PM_STBY_CFG2
.set UART_IntClock__PM_STBY_MSK, 0x02

/* R_Pin */
.set R_Pin__0__INTTYPE, CYREG_PICU2_INTTYPE2
.set R_Pin__0__MASK, 0x04
.set R_Pin__0__PC, CYREG_PRT2_PC2
.set R_Pin__0__PORT, 2
.set R_Pin__0__SHIFT, 2
.set R_Pin__AG, CYREG_PRT2_AG
.set R_Pin__AMUX, CYREG_PRT2_AMUX
.set R_Pin__BIE, CYREG_PRT2_BIE
.set R_Pin__BIT_MASK, CYREG_PRT2_BIT_MASK
.set R_Pin__BYP, CYREG_PRT2_BYP
.set R_Pin__CTL, CYREG_PRT2_CTL
.set R_Pin__DM0, CYREG_PRT2_DM0
.set R_Pin__DM1, CYREG_PRT2_DM1
.set R_Pin__DM2, CYREG_PRT2_DM2
.set R_Pin__DR, CYREG_PRT2_DR
.set R_Pin__INP_DIS, CYREG_PRT2_INP_DIS
.set R_Pin__INTTYPE_BASE, CYDEV_PICU_INTTYPE_PICU2_BASE
.set R_Pin__LCD_COM_SEG, CYREG_PRT2_LCD_COM_SEG
.set R_Pin__LCD_EN, CYREG_PRT2_LCD_EN
.set R_Pin__MASK, 0x04
.set R_Pin__PORT, 2
.set R_Pin__PRT, CYREG_PRT2_PRT
.set R_Pin__PRTDSI__CAPS_SEL, CYREG_PRT2_CAPS_SEL
.set R_Pin__PRTDSI__DBL_SYNC_IN, CYREG_PRT2_DBL_SYNC_IN
.set R_Pin__PRTDSI__OE_SEL0, CYREG_PRT2_OE_SEL0
.set R_Pin__PRTDSI__OE_SEL1, CYREG_PRT2_OE_SEL1
.set R_Pin__PRTDSI__OUT_SEL0, CYREG_PRT2_OUT_SEL0
.set R_Pin__PRTDSI__OUT_SEL1, CYREG_PRT2_OUT_SEL1
.set R_Pin__PRTDSI__SYNC_OUT, CYREG_PRT2_SYNC_OUT
.set R_Pin__PS, CYREG_PRT2_PS
.set R_Pin__SHIFT, 2
.set R_Pin__SLW, CYREG_PRT2_SLW
.set R_Pin_1__0__INTTYPE, CYREG_PICU2_INTTYPE5
.set R_Pin_1__0__MASK, 0x20
.set R_Pin_1__0__PC, CYREG_PRT2_PC5
.set R_Pin_1__0__PORT, 2
.set R_Pin_1__0__SHIFT, 5
.set R_Pin_1__AG, CYREG_PRT2_AG
.set R_Pin_1__AMUX, CYREG_PRT2_AMUX
.set R_Pin_1__BIE, CYREG_PRT2_BIE
.set R_Pin_1__BIT_MASK, CYREG_PRT2_BIT_MASK
.set R_Pin_1__BYP, CYREG_PRT2_BYP
.set R_Pin_1__CTL, CYREG_PRT2_CTL
.set R_Pin_1__DM0, CYREG_PRT2_DM0
.set R_Pin_1__DM1, CYREG_PRT2_DM1
.set R_Pin_1__DM2, CYREG_PRT2_DM2
.set R_Pin_1__DR, CYREG_PRT2_DR
.set R_Pin_1__INP_DIS, CYREG_PRT2_INP_DIS
.set R_Pin_1__INTTYPE_BASE, CYDEV_PICU_INTTYPE_PICU2_BASE
.set R_Pin_1__LCD_COM_SEG, CYREG_PRT2_LCD_COM_SEG
.set R_Pin_1__LCD_EN, CYREG_PRT2_LCD_EN
.set R_Pin_1__MASK, 0x20
.set R_Pin_1__PORT, 2
.set R_Pin_1__PRT, CYREG_PRT2_PRT
.set R_Pin_1__PRTDSI__CAPS_SEL, CYREG_PRT2_CAPS_SEL
.set R_Pin_1__PRTDSI__DBL_SYNC_IN, CYREG_PRT2_DBL_SYNC_IN
.set R_Pin_1__PRTDSI__OE_SEL0, CYREG_PRT2_OE_SEL0
.set R_Pin_1__PRTDSI__OE_SEL1, CYREG_PRT2_OE_SEL1
.set R_Pin_1__PRTDSI__OUT_SEL0, CYREG_PRT2_OUT_SEL0
.set R_Pin_1__PRTDSI__OUT_SEL1, CYREG_PRT2_OUT_SEL1
.set R_Pin_1__PRTDSI__SYNC_OUT, CYREG_PRT2_SYNC_OUT
.set R_Pin_1__PS, CYREG_PRT2_PS
.set R_Pin_1__SHIFT, 5
.set R_Pin_1__SLW, CYREG_PRT2_SLW
.set R_Pin_2__0__INTTYPE, CYREG_PICU2_INTTYPE7
.set R_Pin_2__0__MASK, 0x80
.set R_Pin_2__0__PC, CYREG_PRT2_PC7
.set R_Pin_2__0__PORT, 2
.set R_Pin_2__0__SHIFT, 7
.set R_Pin_2__AG, CYREG_PRT2_AG
.set R_Pin_2__AMUX, CYREG_PRT2_AMUX
.set R_Pin_2__BIE, CYREG_PRT2_BIE
.set R_Pin_2__BIT_MASK, CYREG_PRT2_BIT_MASK
.set R_Pin_2__BYP, CYREG_PRT2_BYP
.set R_Pin_2__CTL, CYREG_PRT2_CTL
.set R_Pin_2__DM0, CYREG_PRT2_DM0
.set R_Pin_2__DM1, CYREG_PRT2_DM1
.set R_Pin_2__DM2, CYREG_PRT2_DM2
.set R_Pin_2__DR, CYREG_PRT2_DR
.set R_Pin_2__INP_DIS, CYREG_PRT2_INP_DIS
.set R_Pin_2__INTTYPE_BASE, CYDEV_PICU_INTTYPE_PICU2_BASE
.set R_Pin_2__LCD_COM_SEG, CYREG_PRT2_LCD_COM_SEG
.set R_Pin_2__LCD_EN, CYREG_PRT2_LCD_EN
.set R_Pin_2__MASK, 0x80
.set R_Pin_2__PORT, 2
.set R_Pin_2__PRT, CYREG_PRT2_PRT
.set R_Pin_2__PRTDSI__CAPS_SEL, CYREG_PRT2_CAPS_SEL
.set R_Pin_2__PRTDSI__DBL_SYNC_IN, CYREG_PRT2_DBL_SYNC_IN
.set R_Pin_2__PRTDSI__OE_SEL0, CYREG_PRT2_OE_SEL0
.set R_Pin_2__PRTDSI__OE_SEL1, CYREG_PRT2_OE_SEL1
.set R_Pin_2__PRTDSI__OUT_SEL0, CYREG_PRT2_OUT_SEL0
.set R_Pin_2__PRTDSI__OUT_SEL1, CYREG_PRT2_OUT_SEL1
.set R_Pin_2__PRTDSI__SYNC_OUT, CYREG_PRT2_SYNC_OUT
.set R_Pin_2__PS, CYREG_PRT2_PS
.set R_Pin_2__SHIFT, 7
.set R_Pin_2__SLW, CYREG_PRT2_SLW
.set R_Pin_3__0__INTTYPE, CYREG_PICU1_INTTYPE2
.set R_Pin_3__0__MASK, 0x04
.set R_Pin_3__0__PC, CYREG_PRT1_PC2
.set R_Pin_3__0__PORT, 1
.set R_Pin_3__0__SHIFT, 2
.set R_Pin_3__AG, CYREG_PRT1_AG
.set R_Pin_3__AMUX, CYREG_PRT1_AMUX
.set R_Pin_3__BIE, CYREG_PRT1_BIE
.set R_Pin_3__BIT_MASK, CYREG_PRT1_BIT_MASK
.set R_Pin_3__BYP, CYREG_PRT1_BYP
.set R_Pin_3__CTL, CYREG_PRT1_CTL
.set R_Pin_3__DM0, CYREG_PRT1_DM0
.set R_Pin_3__DM1, CYREG_PRT1_DM1
.set R_Pin_3__DM2, CYREG_PRT1_DM2
.set R_Pin_3__DR, CYREG_PRT1_DR
.set R_Pin_3__INP_DIS, CYREG_PRT1_INP_DIS
.set R_Pin_3__INTTYPE_BASE, CYDEV_PICU_INTTYPE_PICU1_BASE
.set R_Pin_3__LCD_COM_SEG, CYREG_PRT1_LCD_COM_SEG
.set R_Pin_3__LCD_EN, CYREG_PRT1_LCD_EN
.set R_Pin_3__MASK, 0x04
.set R_Pin_3__PORT, 1
.set R_Pin_3__PRT, CYREG_PRT1_PRT
.set R_Pin_3__PRTDSI__CAPS_SEL, CYREG_PRT1_CAPS_SEL
.set R_Pin_3__PRTDSI__DBL_SYNC_IN, CYREG_PRT1_DBL_SYNC_IN
.set R_Pin_3__PRTDSI__OE_SEL0, CYREG_PRT1_OE_SEL0
.set R_Pin_3__PRTDSI__OE_SEL1, CYREG_PRT1_OE_SEL1
.set R_Pin_3__PRTDSI__OUT_SEL0, CYREG_PRT1_OUT_SEL0
.set R_Pin_3__PRTDSI__OUT_SEL1, CYREG_PRT1_OUT_SEL1
.set R_Pin_3__PRTDSI__SYNC_OUT, CYREG_PRT1_SYNC_OUT
.set R_Pin_3__PS, CYREG_PRT1_PS
.set R_Pin_3__SHIFT, 2
.set R_Pin_3__SLW, CYREG_PRT1_SLW

/* Timer */
.set Timer_TimerHW__CAP0, CYREG_TMR0_CAP0
.set Timer_TimerHW__CAP1, CYREG_TMR0_CAP1
.set Timer_TimerHW__CFG0, CYREG_TMR0_CFG0
.set Timer_TimerHW__CFG1, CYREG_TMR0_CFG1
.set Timer_TimerHW__CFG2, CYREG_TMR0_CFG2
.set Timer_TimerHW__CNT_CMP0, CYREG_TMR0_CNT_CMP0
.set Timer_TimerHW__CNT_CMP1, CYREG_TMR0_CNT_CMP1
.set Timer_TimerHW__PER0, CYREG_TMR0_PER0
.set Timer_TimerHW__PER1, CYREG_TMR0_PER1
.set Timer_TimerHW__PM_ACT_CFG, CYREG_PM_ACT_CFG3
.set Timer_TimerHW__PM_ACT_MSK, 0x01
.set Timer_TimerHW__PM_STBY_CFG, CYREG_PM_STBY_CFG3
.set Timer_TimerHW__PM_STBY_MSK, 0x01
.set Timer_TimerHW__RT0, CYREG_TMR0_RT0
.set Timer_TimerHW__RT1, CYREG_TMR0_RT1
.set Timer_TimerHW__SR0, CYREG_TMR0_SR0

/* isr_ADC */
.set isr_ADC__INTC_CLR_EN_REG, CYREG_NVIC_CLRENA0
.set isr_ADC__INTC_CLR_PD_REG, CYREG_NVIC_CLRPEND0
.set isr_ADC__INTC_MASK, 0x01
.set isr_ADC__INTC_NUMBER, 0
.set isr_ADC__INTC_PRIOR_NUM, 7
.set isr_ADC__INTC_PRIOR_REG, CYREG_NVIC_PRI_0
.set isr_ADC__INTC_SET_EN_REG, CYREG_NVIC_SETENA0
.set isr_ADC__INTC_SET_PD_REG, CYREG_NVIC_SETPEND0

/* ADC_DelSig */
.set ADC_DelSig_DEC__COHER, CYREG_DEC_COHER
.set ADC_DelSig_DEC__CR, CYREG_DEC_CR
.set ADC_DelSig_DEC__DR1, CYREG_DEC_DR1
.set ADC_DelSig_DEC__DR2, CYREG_DEC_DR2
.set ADC_DelSig_DEC__DR2H, CYREG_DEC_DR2H
.set ADC_DelSig_DEC__GCOR, CYREG_DEC_GCOR
.set ADC_DelSig_DEC__GCORH, CYREG_DEC_GCORH
.set ADC_DelSig_DEC__GVAL, CYREG_DEC_GVAL
.set ADC_DelSig_DEC__OCOR, CYREG_DEC_OCOR
.set ADC_DelSig_DEC__OCORH, CYREG_DEC_OCORH
.set ADC_DelSig_DEC__OCORM, CYREG_DEC_OCORM
.set ADC_DelSig_DEC__OUTSAMP, CYREG_DEC_OUTSAMP
.set ADC_DelSig_DEC__OUTSAMPH, CYREG_DEC_OUTSAMPH
.set ADC_DelSig_DEC__OUTSAMPM, CYREG_DEC_OUTSAMPM
.set ADC_DelSig_DEC__OUTSAMPS, CYREG_DEC_OUTSAMPS
.set ADC_DelSig_DEC__PM_ACT_CFG, CYREG_PM_ACT_CFG10
.set ADC_DelSig_DEC__PM_ACT_MSK, 0x01
.set ADC_DelSig_DEC__PM_STBY_CFG, CYREG_PM_STBY_CFG10
.set ADC_DelSig_DEC__PM_STBY_MSK, 0x01
.set ADC_DelSig_DEC__SHIFT1, CYREG_DEC_SHIFT1
.set ADC_DelSig_DEC__SHIFT2, CYREG_DEC_SHIFT2
.set ADC_DelSig_DEC__SR, CYREG_DEC_SR
.set ADC_DelSig_DEC__TRIM__M1, CYREG_FLSHID_CUST_TABLES_DEC_M1
.set ADC_DelSig_DEC__TRIM__M2, CYREG_FLSHID_CUST_TABLES_DEC_M2
.set ADC_DelSig_DEC__TRIM__M3, CYREG_FLSHID_CUST_TABLES_DEC_M3
.set ADC_DelSig_DEC__TRIM__M4, CYREG_FLSHID_CUST_TABLES_DEC_M4
.set ADC_DelSig_DEC__TRIM__M5, CYREG_FLSHID_CUST_TABLES_DEC_M5
.set ADC_DelSig_DEC__TRIM__M6, CYREG_FLSHID_CUST_TABLES_DEC_M6
.set ADC_DelSig_DEC__TRIM__M7, CYREG_FLSHID_CUST_TABLES_DEC_M7
.set ADC_DelSig_DEC__TRIM__M8, CYREG_FLSHID_CUST_TABLES_DEC_M8
.set ADC_DelSig_DSM__BUF0, CYREG_DSM0_BUF0
.set ADC_DelSig_DSM__BUF1, CYREG_DSM0_BUF1
.set ADC_DelSig_DSM__BUF2, CYREG_DSM0_BUF2
.set ADC_DelSig_DSM__BUF3, CYREG_DSM0_BUF3
.set ADC_DelSig_DSM__CLK, CYREG_DSM0_CLK
.set ADC_DelSig_DSM__CR0, CYREG_DSM0_CR0
.set ADC_DelSig_DSM__CR1, CYREG_DSM0_CR1
.set ADC_DelSig_DSM__CR10, CYREG_DSM0_CR10
.set ADC_DelSig_DSM__CR11, CYREG_DSM0_CR11
.set ADC_DelSig_DSM__CR12, CYREG_DSM0_CR12
.set ADC_DelSig_DSM__CR13, CYREG_DSM0_CR13
.set ADC_DelSig_DSM__CR14, CYREG_DSM0_CR14
.set ADC_DelSig_DSM__CR15, CYREG_DSM0_CR15
.set ADC_DelSig_DSM__CR16, CYREG_DSM0_CR16
.set ADC_DelSig_DSM__CR17, CYREG_DSM0_CR17
.set ADC_DelSig_DSM__CR2, CYREG_DSM0_CR2
.set ADC_DelSig_DSM__CR3, CYREG_DSM0_CR3
.set ADC_DelSig_DSM__CR4, CYREG_DSM0_CR4
.set ADC_DelSig_DSM__CR5, CYREG_DSM0_CR5
.set ADC_DelSig_DSM__CR6, CYREG_DSM0_CR6
.set ADC_DelSig_DSM__CR7, CYREG_DSM0_CR7
.set ADC_DelSig_DSM__CR8, CYREG_DSM0_CR8
.set ADC_DelSig_DSM__CR9, CYREG_DSM0_CR9
.set ADC_DelSig_DSM__DEM0, CYREG_DSM0_DEM0
.set ADC_DelSig_DSM__DEM1, CYREG_DSM0_DEM1
.set ADC_DelSig_DSM__MISC, CYREG_DSM0_MISC
.set ADC_DelSig_DSM__OUT0, CYREG_DSM0_OUT0
.set ADC_DelSig_DSM__OUT1, CYREG_DSM0_OUT1
.set ADC_DelSig_DSM__REF0, CYREG_DSM0_REF0
.set ADC_DelSig_DSM__REF1, CYREG_DSM0_REF1
.set ADC_DelSig_DSM__REF2, CYREG_DSM0_REF2
.set ADC_DelSig_DSM__REF3, CYREG_DSM0_REF3
.set ADC_DelSig_DSM__RSVD1, CYREG_DSM0_RSVD1
.set ADC_DelSig_DSM__SW0, CYREG_DSM0_SW0
.set ADC_DelSig_DSM__SW2, CYREG_DSM0_SW2
.set ADC_DelSig_DSM__SW3, CYREG_DSM0_SW3
.set ADC_DelSig_DSM__SW4, CYREG_DSM0_SW4
.set ADC_DelSig_DSM__SW6, CYREG_DSM0_SW6
.set ADC_DelSig_DSM__TR0, CYREG_NPUMP_DSM_TR0
.set ADC_DelSig_DSM__TST0, CYREG_DSM0_TST0
.set ADC_DelSig_DSM__TST1, CYREG_DSM0_TST1
.set ADC_DelSig_Ext_CP_Clk__CFG0, CYREG_CLKDIST_DCFG0_CFG0
.set ADC_DelSig_Ext_CP_Clk__CFG1, CYREG_CLKDIST_DCFG0_CFG1
.set ADC_DelSig_Ext_CP_Clk__CFG2, CYREG_CLKDIST_DCFG0_CFG2
.set ADC_DelSig_Ext_CP_Clk__CFG2_SRC_SEL_MASK, 0x07
.set ADC_DelSig_Ext_CP_Clk__INDEX, 0x00
.set ADC_DelSig_Ext_CP_Clk__PM_ACT_CFG, CYREG_PM_ACT_CFG2
.set ADC_DelSig_Ext_CP_Clk__PM_ACT_MSK, 0x01
.set ADC_DelSig_Ext_CP_Clk__PM_STBY_CFG, CYREG_PM_STBY_CFG2
.set ADC_DelSig_Ext_CP_Clk__PM_STBY_MSK, 0x01
.set ADC_DelSig_IRQ__INTC_CLR_EN_REG, CYREG_NVIC_CLRENA0
.set ADC_DelSig_IRQ__INTC_CLR_PD_REG, CYREG_NVIC_CLRPEND0
.set ADC_DelSig_IRQ__INTC_MASK, 0x20000000
.set ADC_DelSig_IRQ__INTC_NUMBER, 29
.set ADC_DelSig_IRQ__INTC_PRIOR_NUM, 7
.set ADC_DelSig_IRQ__INTC_PRIOR_REG, CYREG_NVIC_PRI_29
.set ADC_DelSig_IRQ__INTC_SET_EN_REG, CYREG_NVIC_SETENA0
.set ADC_DelSig_IRQ__INTC_SET_PD_REG, CYREG_NVIC_SETPEND0
.set ADC_DelSig_theACLK__CFG0, CYREG_CLKDIST_ACFG0_CFG0
.set ADC_DelSig_theACLK__CFG1, CYREG_CLKDIST_ACFG0_CFG1
.set ADC_DelSig_theACLK__CFG2, CYREG_CLKDIST_ACFG0_CFG2
.set ADC_DelSig_theACLK__CFG2_SRC_SEL_MASK, 0x07
.set ADC_DelSig_theACLK__CFG3, CYREG_CLKDIST_ACFG0_CFG3
.set ADC_DelSig_theACLK__CFG3_PHASE_DLY_MASK, 0x0F
.set ADC_DelSig_theACLK__INDEX, 0x00
.set ADC_DelSig_theACLK__PM_ACT_CFG, CYREG_PM_ACT_CFG1
.set ADC_DelSig_theACLK__PM_ACT_MSK, 0x01
.set ADC_DelSig_theACLK__PM_STBY_CFG, CYREG_PM_STBY_CFG1
.set ADC_DelSig_theACLK__PM_STBY_MSK, 0x01

/* Clock_Timer_ADC */
.set Clock_Timer_ADC__CFG0, CYREG_CLKDIST_DCFG2_CFG0
.set Clock_Timer_ADC__CFG1, CYREG_CLKDIST_DCFG2_CFG1
.set Clock_Timer_ADC__CFG2, CYREG_CLKDIST_DCFG2_CFG2
.set Clock_Timer_ADC__CFG2_SRC_SEL_MASK, 0x07
.set Clock_Timer_ADC__INDEX, 0x02
.set Clock_Timer_ADC__PM_ACT_CFG, CYREG_PM_ACT_CFG2
.set Clock_Timer_ADC__PM_ACT_MSK, 0x04
.set Clock_Timer_ADC__PM_STBY_CFG, CYREG_PM_STBY_CFG2
.set Clock_Timer_ADC__PM_STBY_MSK, 0x04

/* Miscellaneous */
.set BCLK__BUS_CLK__HZ, 24000000
.set BCLK__BUS_CLK__KHZ, 24000
.set BCLK__BUS_CLK__MHZ, 24
.set CYDEV_CHIP_DIE_LEOPARD, 1
.set CYDEV_CHIP_DIE_PSOC4A, 26
.set CYDEV_CHIP_DIE_PSOC5LP, 2
.set CYDEV_CHIP_DIE_PSOC5TM, 3
.set CYDEV_CHIP_DIE_TMA4, 4
.set CYDEV_CHIP_DIE_UNKNOWN, 0
.set CYDEV_CHIP_FAMILY_FM0P, 5
.set CYDEV_CHIP_FAMILY_FM3, 6
.set CYDEV_CHIP_FAMILY_FM4, 7
.set CYDEV_CHIP_FAMILY_PSOC3, 1
.set CYDEV_CHIP_FAMILY_PSOC4, 2
.set CYDEV_CHIP_FAMILY_PSOC5, 3
.set CYDEV_CHIP_FAMILY_PSOC6, 4
.set CYDEV_CHIP_FAMILY_UNKNOWN, 0
.set CYDEV_CHIP_FAMILY_USED, CYDEV_CHIP_FAMILY_PSOC5
.set CYDEV_CHIP_JTAG_ID, 0x2E161069
.set CYDEV_CHIP_MEMBER_3A, 1
.set CYDEV_CHIP_MEMBER_4A, 26
.set CYDEV_CHIP_MEMBER_4AA, 25
.set CYDEV_CHIP_MEMBER_4AB, 30
.set CYDEV_CHIP_MEMBER_4AC, 14
.set CYDEV_CHIP_MEMBER_4AD, 15
.set CYDEV_CHIP_MEMBER_4AE, 16
.set CYDEV_CHIP_MEMBER_4D, 20
.set CYDEV_CHIP_MEMBER_4E, 6
.set CYDEV_CHIP_MEMBER_4F, 27
.set CYDEV_CHIP_MEMBER_4G, 4
.set CYDEV_CHIP_MEMBER_4H, 24
.set CYDEV_CHIP_MEMBER_4I, 32
.set CYDEV_CHIP_MEMBER_4J, 21
.set CYDEV_CHIP_MEMBER_4K, 22
.set CYDEV_CHIP_MEMBER_4L, 31
.set CYDEV_CHIP_MEMBER_4M, 29
.set CYDEV_CHIP_MEMBER_4N, 11
.set CYDEV_CHIP_MEMBER_4O, 8
.set CYDEV_CHIP_MEMBER_4P, 28
.set CYDEV_CHIP_MEMBER_4Q, 17
.set CYDEV_CHIP_MEMBER_4R, 9
.set CYDEV_CHIP_MEMBER_4S, 12
.set CYDEV_CHIP_MEMBER_4T, 10
.set CYDEV_CHIP_MEMBER_4U, 5
.set CYDEV_CHIP_MEMBER_4V, 23
.set CYDEV_CHIP_MEMBER_4W, 13
.set CYDEV_CHIP_MEMBER_4X, 7
.set CYDEV_CHIP_MEMBER_4Y, 18
.set CYDEV_CHIP_MEMBER_4Z, 19
.set CYDEV_CHIP_MEMBER_5A, 3
.set CYDEV_CHIP_MEMBER_5B, 2
.set CYDEV_CHIP_MEMBER_6A, 33
.set CYDEV_CHIP_MEMBER_FM3, 37
.set CYDEV_CHIP_MEMBER_FM4, 38
.set CYDEV_CHIP_MEMBER_PDL_FM0P_TYPE1, 34
.set CYDEV_CHIP_MEMBER_PDL_FM0P_TYPE2, 35
.set CYDEV_CHIP_MEMBER_PDL_FM0P_TYPE3, 36
.set CYDEV_CHIP_MEMBER_UNKNOWN, 0
.set CYDEV_CHIP_MEMBER_USED, CYDEV_CHIP_MEMBER_5B
.set CYDEV_CHIP_DIE_EXPECT, CYDEV_CHIP_MEMBER_USED
.set CYDEV_CHIP_DIE_ACTUAL, CYDEV_CHIP_DIE_EXPECT
.set CYDEV_CHIP_REV_LEOPARD_ES1, 0
.set CYDEV_CHIP_REV_LEOPARD_ES2, 1
.set CYDEV_CHIP_REV_LEOPARD_ES3, 3
.set CYDEV_CHIP_REV_LEOPARD_PRODUCTION, 3
.set CYDEV_CHIP_REV_PSOC4A_ES0, 17
.set CYDEV_CHIP_REV_PSOC4A_PRODUCTION, 17
.set CYDEV_CHIP_REV_PSOC5LP_ES0, 0
.set CYDEV_CHIP_REV_PSOC5LP_PRODUCTION, 0
.set CYDEV_CHIP_REV_PSOC5TM_ES0, 0
.set CYDEV_CHIP_REV_PSOC5TM_ES1, 1
.set CYDEV_CHIP_REV_PSOC5TM_PRODUCTION, 1
.set CYDEV_CHIP_REV_TMA4_ES, 17
.set CYDEV_CHIP_REV_TMA4_ES2, 33
.set CYDEV_CHIP_REV_TMA4_PRODUCTION, 17
.set CYDEV_CHIP_REVISION_3A_ES1, 0
.set CYDEV_CHIP_REVISION_3A_ES2, 1
.set CYDEV_CHIP_REVISION_3A_ES3, 3
.set CYDEV_CHIP_REVISION_3A_PRODUCTION, 3
.set CYDEV_CHIP_REVISION_4A_ES0, 17
.set CYDEV_CHIP_REVISION_4A_PRODUCTION, 17
.set CYDEV_CHIP_REVISION_4AA_PRODUCTION, 0
.set CYDEV_CHIP_REVISION_4AB_PRODUCTION, 0
.set CYDEV_CHIP_REVISION_4AC_PRODUCTION, 0
.set CYDEV_CHIP_REVISION_4AD_PRODUCTION, 0
.set CYDEV_CHIP_REVISION_4AE_PRODUCTION, 0
.set CYDEV_CHIP_REVISION_4D_PRODUCTION, 0
.set CYDEV_CHIP_REVISION_4E_CCG2_NO_USBPD, 0
.set CYDEV_CHIP_REVISION_4E_PRODUCTION, 0
.set CYDEV_CHIP_REVISION_4F_PRODUCTION, 0
.set CYDEV_CHIP_REVISION_4F_PRODUCTION_256DMA, 0
.set CYDEV_CHIP_REVISION_4F_PRODUCTION_256K, 0
.set CYDEV_CHIP_REVISION_4G_ES, 17
.set CYDEV_CHIP_REVISION_4G_ES2, 33
.set CYDEV_CHIP_REVISION_4G_PRODUCTION, 17
.set CYDEV_CHIP_REVISION_4H_PRODUCTION, 0
.set CYDEV_CHIP_REVISION_4I_PRODUCTION, 0
.set CYDEV_CHIP_REVISION_4J_PRODUCTION, 0
.set CYDEV_CHIP_REVISION_4K_PRODUCTION, 0
.set CYDEV_CHIP_REVISION_4L_PRODUCTION, 0
.set CYDEV_CHIP_REVISION_4M_PRODUCTION, 0
.set CYDEV_CHIP_REVISION_4N_PRODUCTION, 0
.set CYDEV_CHIP_REVISION_4O_PRODUCTION, 0
.set CYDEV_CHIP_REVISION_4P_PRODUCTION, 0
.set CYDEV_CHIP_REVISION_4Q_PRODUCTION, 0
.set CYDEV_CHIP_REVISION_4R_PRODUCTION, 0
.set CYDEV_CHIP_REVISION_4S_PRODUCTION, 0
.set CYDEV_CHIP_REVISION_4T_PRODUCTION, 0
.set CYDEV_CHIP_REVISION_4U_PRODUCTION, 0
.set CYDEV_CHIP_REVISION_4V_PRODUCTION, 0
.set CYDEV_CHIP_REVISION_4W_PRODUCTION, 0
.set CYDEV_CHIP_REVISION_4X_PRODUCTION, 0
.set CYDEV_CHIP_REVISION_4Y_PRODUCTION, 0
.set CYDEV_CHIP_REVISION_4Z_PRODUCTION, 0
.set CYDEV_CHIP_REVISION_5A_ES0, 0
.set CYDEV_CHIP_REVISION_5A_ES1, 1
.set CYDEV_CHIP_REVISION_5A_PRODUCTION, 1
.set CYDEV_CHIP_REVISION_5B_ES0, 0
.set CYDEV_CHIP_REVISION_5B_PRODUCTION, 0
.set CYDEV_CHIP_REVISION_6A_ES, 17
.set CYDEV_CHIP_REVISION_6A_NO_UDB, 33
.set CYDEV_CHIP_REVISION_6A_PRODUCTION, 33
.set CYDEV_CHIP_REVISION_FM3_PRODUCTION, 0
.set CYDEV_CHIP_REVISION_FM4_PRODUCTION, 0
.set CYDEV_CHIP_REVISION_PDL_FM0P_TYPE1_PRODUCTION, 0
.set CYDEV_CHIP_REVISION_PDL_FM0P_TYPE2_PRODUCTION, 0
.set CYDEV_CHIP_REVISION_PDL_FM0P_TYPE3_PRODUCTION, 0
.set CYDEV_CHIP_REVISION_USED, CYDEV_CHIP_REVISION_5B_PRODUCTION
.set CYDEV_CHIP_REV_EXPECT, CYDEV_CHIP_REVISION_USED
.set CYDEV_CONFIG_FASTBOOT_ENABLED, 1
.set CYDEV_CONFIG_UNUSED_IO_AllowButWarn, 0
.set CYDEV_CONFIG_UNUSED_IO, CYDEV_CONFIG_UNUSED_IO_AllowButWarn
.set CYDEV_CONFIG_UNUSED_IO_AllowWithInfo, 1
.set CYDEV_CONFIG_UNUSED_IO_Disallowed, 2
.set CYDEV_CONFIGURATION_COMPRESSED, 1
.set CYDEV_CONFIGURATION_DMA, 0
.set CYDEV_CONFIGURATION_ECC, 1
.set CYDEV_CONFIGURATION_IMOENABLED, CYDEV_CONFIG_FASTBOOT_ENABLED
.set CYDEV_CONFIGURATION_MODE_COMPRESSED, 0
.set CYDEV_CONFIGURATION_MODE, CYDEV_CONFIGURATION_MODE_COMPRESSED
.set CYDEV_CONFIGURATION_MODE_DMA, 2
.set CYDEV_CONFIGURATION_MODE_UNCOMPRESSED, 1
.set CYDEV_DEBUG_ENABLE_MASK, 0x20
.set CYDEV_DEBUG_ENABLE_REGISTER, CYREG_MLOGIC_DEBUG
.set CYDEV_DEBUGGING_DPS_Disable, 3
.set CYDEV_DEBUGGING_DPS_JTAG_4, 1
.set CYDEV_DEBUGGING_DPS_JTAG_5, 0
.set CYDEV_DEBUGGING_DPS_SWD, 2
.set CYDEV_DEBUGGING_DPS_SWD_SWV, 6
.set CYDEV_DEBUGGING_DPS, CYDEV_DEBUGGING_DPS_SWD_SWV
.set CYDEV_DEBUGGING_ENABLE, 1
.set CYDEV_DEBUGGING_XRES, 0
.set CYDEV_DMA_CHANNELS_AVAILABLE, 24
.set CYDEV_ECC_ENABLE, 0
.set CYDEV_HEAP_SIZE, 0x80
.set CYDEV_INSTRUCT_CACHE_ENABLED, 1
.set CYDEV_INTR_RISING, 0x00000000
.set CYDEV_IS_EXPORTING_CODE, 0
.set CYDEV_IS_IMPORTING_CODE, 0
.set CYDEV_PROJ_TYPE, 0
.set CYDEV_PROJ_TYPE_BOOTLOADER, 1
.set CYDEV_PROJ_TYPE_LAUNCHER, 5
.set CYDEV_PROJ_TYPE_LOADABLE, 2
.set CYDEV_PROJ_TYPE_LOADABLEANDBOOTLOADER, 4
.set CYDEV_PROJ_TYPE_MULTIAPPBOOTLOADER, 3
.set CYDEV_PROJ_TYPE_STANDARD, 0
.set CYDEV_PROTECTION_ENABLE, 0
.set CYDEV_STACK_SIZE, 0x0800
.set CYDEV_USE_BUNDLED_CMSIS, 1
.set CYDEV_VARIABLE_VDDA, 0
.set CYDEV_VDDA_MV, 3300
.set CYDEV_VDDD_MV, 3300
.set CYDEV_VDDIO0_MV, 3300
.set CYDEV_VDDIO1_MV, 3300
.set CYDEV_VDDIO2_MV, 3300
.set CYDEV_VDDIO3_MV, 3300
.set CYDEV_VIO0_MV, 3300
.set CYDEV_VIO1_MV, 3300
.set CYDEV_VIO2_MV, 3300
.set CYDEV_VIO3_MV, 3300
.set CYIPBLOCK_ARM_CM3_VERSION, 0
.set CYIPBLOCK_P3_ANAIF_VERSION, 0
.set CYIPBLOCK_P3_CAN_VERSION, 0
.set CYIPBLOCK_P3_CAPSENSE_VERSION, 0
.set CYIPBLOCK_P3_COMP_VERSION, 0
.set CYIPBLOCK_P3_DECIMATOR_VERSION, 0
.set CYIPBLOCK_P3_DFB_VERSION, 0
.set CYIPBLOCK_P3_DMA_VERSION, 0
.set CYIPBLOCK_P3_DRQ_VERSION, 0
.set CYIPBLOCK_P3_DSM_VERSION, 0
.set CYIPBLOCK_P3_EMIF_VERSION, 0
.set CYIPBLOCK_P3_I2C_VERSION, 0
.set CYIPBLOCK_P3_LCD_VERSION, 0
.set CYIPBLOCK_P3_LPF_VERSION, 0
.set CYIPBLOCK_P3_OPAMP_VERSION, 0
.set CYIPBLOCK_P3_PM_VERSION, 0
.set CYIPBLOCK_P3_SCCT_VERSION, 0
.set CYIPBLOCK_P3_TIMER_VERSION, 0
.set CYIPBLOCK_P3_USB_VERSION, 0
.set CYIPBLOCK_P3_VIDAC_VERSION, 0
.set CYIPBLOCK_P3_VREF_VERSION, 0
.set CYIPBLOCK_S8_GPIO_VERSION, 0
.set CYIPBLOCK_S8_IRQ_VERSION, 0
.set CYIPBLOCK_S8_SAR_VERSION, 0
.set CYIPBLOCK_S8_SIO_VERSION, 0
.set CYIPBLOCK_S8_UDB_VERSION, 0
.set DMA_CHANNELS_USED__MASK0, 0x00000000
.set CYDEV_BOOTLOADER_ENABLE, 0
.endif
